## ardo_v2/esp1_oido_boca/sdkconfig.defaults
```kconfig
# sdkconfig.defaults — ESP1 Oído+Boca
# ESP32-S3 Supermini (4MB Flash, NO PSRAM)

CONFIG_IDF_TARGET="esp32s3"

# PSRAM — disabled (board has no PSRAM)
CONFIG_SPIRAM=n

# Flash
CONFIG_ESPTOOLPY_FLASHSIZE_4MB=y
CONFIG_ESPTOOLPY_FLASHFREQ_80M=y

# Partitions
CONFIG_PARTITION_TABLE_CUSTOM=y
CONFIG_PARTITION_TABLE_CUSTOM_FILENAME="partitions.csv"

# WiFi
CONFIG_ESP_WIFI_STATIC_RX_BUFFER_NUM=10
CONFIG_ESP_WIFI_DYNAMIC_RX_BUFFER_NUM=32
CONFIG_ESP_WIFI_DYNAMIC_TX_BUFFER_NUM=32

# Stack / heap
CONFIG_ESP_MAIN_TASK_STACK_SIZE=8192
CONFIG_MAIN_TASK_STACK_SIZE=8192

# Logging
CONFIG_LOG_DEFAULT_LEVEL_INFO=y

# lwIP (TCP/IP) — aumentar buffers para streaming
CONFIG_LWIP_TCP_SND_BUF_DEFAULT=65535
CONFIG_LWIP_TCP_WND_DEFAULT=65535
CONFIG_LWIP_TCP_RECVMBOX_SIZE=16

# FreeRTOS
CONFIG_FREERTOS_HZ=1000
CONFIG_FREERTOS_USE_TICKLESS_IDLE=n
```

## ardo_v2/esp2_cerebro_motor/sdkconfig.defaults
```kconfig
# sdkconfig.defaults — ESP2 Cerebro+Motor
# ESP32-S3 Supermini (4MB Flash, NO PSRAM)

CONFIG_IDF_TARGET="esp32s3"

# PSRAM — disabled
CONFIG_SPIRAM=n

# Flash
CONFIG_ESPTOOLPY_FLASHSIZE_4MB=y
CONFIG_ESPTOOLPY_FLASHFREQ_80M=y

# Partitions
CONFIG_PARTITION_TABLE_CUSTOM=y
CONFIG_PARTITION_TABLE_CUSTOM_FILENAME="partitions.csv"

# Stack / heap
CONFIG_ESP_MAIN_TASK_STACK_SIZE=8192

# Logging
CONFIG_LOG_DEFAULT_LEVEL_INFO=y

# FreeRTOS
CONFIG_FREERTOS_HZ=1000
```
